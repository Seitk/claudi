## firmware/components/claudi_board/Kconfig
```kconfig
menu "claudi board"

choice CLAUDI_BOARD
    prompt "Target board"
    default CLAUDI_BOARD_AMOLED175
    help
        Selects which claudi_board implementation is compiled in.

    config CLAUDI_BOARD_AMOLED175
        bool "Waveshare ESP32-S3-Touch-AMOLED-1.75 (466x466 round)"

    config CLAUDI_BOARD_WATCH169
        bool "ESPWatch 1.69 (240x280 ST7789V2) [Phase 2 — stub]"
endchoice

endmenu
```

## firmware/sdkconfig.defaults.amoled175
```kconfig
# Board overlay: Waveshare ESP32-S3-Touch-AMOLED-1.75
# 466x466 round CO5300 (QSPI), CST9217 touch, AXP2101 PMU, 32MB flash.
CONFIG_CLAUDI_BOARD_AMOLED175=y
CONFIG_ESPTOOLPY_FLASHSIZE_32MB=y
CONFIG_PARTITION_TABLE_CUSTOM_FILENAME="partitions_amoled175.csv"
```

## firmware/sdkconfig.defaults.watch169
```kconfig
# Board overlay: ESPWatch 1.69 (Waveshare ESP32-S3-Touch-LCD-1.69 class)
# 240x280 ST7789V2 (SPI), CST816 touch, QMI8658 IMU, no PMU, 16MB flash.
CONFIG_CLAUDI_BOARD_WATCH169=y
CONFIG_ESPTOOLPY_FLASHSIZE_16MB=y
CONFIG_PARTITION_TABLE_CUSTOM_FILENAME="partitions_watch169.csv"
```
